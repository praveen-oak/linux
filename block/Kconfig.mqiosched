## block/Kconfig.mqiosched
```kconfig
if BLOCK

menu "Multi-queue IO Schedulers"

config IOSCHED_MQFQ
	tristate "Multi-queue Fairness I/O Scheduler"
	default y
	---help---
	  The multi-queue I/O scheduler is targeted for SSDs. It
	  provides fairness between processes at high IO throughput 
	  and low cost of CPU cycles.

	  This is the default I/O scheduler for multi-queue enabled block
	  devices. 

endmenu

endif
```

## drivers/block/ahci/Kconfig
```kconfig
#
# mtip32xx device driver configuration
#

config BLK_DEV_AHCI
	tristate "Block Device Driver for AHCI"
	depends on PCI 
	help
          This enables the block driver for AHCI.
```

## fs/btrfscore/Kconfig
```kconfig
config BTRFS_CORE_FS
	tristate "Btrfs core filesystem support"
	select LIBCRC32C
	select ZLIB_INFLATE
	select ZLIB_DEFLATE
	select LZO_COMPRESS
	select LZO_DECOMPRESS

	help
	  Btrfs core is the core tree implementation of btrfs.

	  Btrfs core is highly experimental. It require special hardware that 
	  allows btrfs to pass tree operations toward the block interface.
	  Furthermore, THE DISK FORMAT IS NOT YET FINALIZED.  You should 
	  say N here unless you are interested in testing Btrfs with 
	  non-critical data.

	  To compile this part of btrfssupport as a module, choose M here. The
	  module will be called btrfscore.

	  If unsure, say N.

config BTRFS_CORE_DEBUG
	bool "Btrfs core debugging support"
	depends on BTRFS_CORE_FS
	depends on BTRFS_FS
	help
	  Enable run-time debugging support for the btrfs filesystem. This may
	  enable additional and expensive checks with negative impact on
	  performance, or export extra information via sysfs.

	  If unsure, say N.
```
